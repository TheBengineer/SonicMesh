## firmware/Kconfig
```kconfig
menuconfig SONICMESH
	bool "SonicMesh acoustic node framework"
	help
	  Audio capture, detector framework and the BLE Coded PHY broadcast used by SonicMesh nodes and
	  gateways. See firmware/README.md.

if SONICMESH

choice SM_ROLE
	prompt "Role"
	default SM_ROLE_NODE

config SM_ROLE_NODE
	bool "Sensor node"
	select AUDIO
	select AUDIO_DMIC
	select BT_BROADCASTER
	select BT_OBSERVER
	help
	  Captures audio, runs every enabled detector and broadcasts their records.

config SM_ROLE_GATEWAY
	bool "Gateway"
	select BT_BROADCASTER
	select BT_OBSERVER
	help
	  Listens for node records, prints them on USB serial and broadcasts the time sync beacon.

endchoice

config SM_ADV_INTERVAL_MS
	int "Node advertising interval (ms)"
	default 100
	help
	  How often a node with pending records transmits a frame. Each record rides in
	  SM_RECORD_REPEATS consecutive frames.

config SM_RECORD_REPEATS
	int "Frames each record is repeated in (default of parameter radio.repeats)"
	default 5
	range 1 20
	help
	  Broadcast has no acknowledgements, so each record is sent this many times. The gateway drops
	  repeats by (node, record id).

config SM_FRAME_MAX
	int "Largest frame payload (bytes)"
	default 180
	range 40 240
	help
	  Upper bound on a frame's SonicMesh payload. Longer frames take longer on air: about 8 us per bit
	  on Coded S8, so 180 bytes is about 12 ms.

config SM_RECORD_POOL
	int "Records waiting to be sent"
	default 32

config SM_SYNC_PERIOD_MS
	int "Gateway sync beacon period (ms)"
	default 1000

config SM_HEALTH_PERIOD_S
	int "Node health record period, s (default of parameter health.period_s)"
	default 10

if SM_ROLE_NODE

config SM_NODE_SCAN_INTERVAL_MS
	int "Node scan interval for sync beacons (ms)"
	default 110
	help
	  Kept off any multiple of the beacon period, so the window drifts over the beacon times and
	  catches some of them, instead of locking onto a phase that never sees one.

config SM_NODE_SCAN_WINDOW_MS
	int "Node scan window for sync beacons (ms)"
	default 30
	help
	  Listening time per interval. The node's single radio cannot advertise while it listens, so a
	  continuous scan cost most of the node's own frames. 0 turns scanning off (no time sync).

config SM_AUDIO_RATE
	int "Audio sample rate (Hz)"
	default 16000

config SM_AUDIO_BLOCK_SAMPLES
	int "Samples per audio block"
	default 512
	help
	  Audio reaches detectors in blocks of this size. 512 samples at 16 kHz is 32 ms, the comb's hop.

config SM_AUDIO_BLOCKS
	int "Audio blocks in the pool"
	default 12
	help
	  Blocks are shared by every detector and freed when the last one is done. A detector that falls
	  behind by more than this many blocks loses blocks and counts them.

config SM_DETECTOR_QUEUE
	int "Blocks a detector may fall behind by"
	default 6
	help
	  Must be below SM_AUDIO_BLOCKS, so one slow detector drops its own blocks (counted as drops)
	  instead of taking the whole pool and stopping capture.

config SM_MIC_FULL_SCALE_DB_SPL
	int "Sound level at digital full scale, dB SPL (default of parameter audio.full_scale_db)"
	default 120
	help
	  Converts samples to pascals. 120 dB SPL fits the XIAO Sense MSM261D3526H1CPM's stated -26 dBFS
	  at 94 dB SPL with the PDM gain at its default. Assumed, not calibrated.

config SM_DETECTOR_DRONE_COMB
	bool "Drone harmonic comb detector"
	default y

config SM_DETECTOR_DRONE_COMB_UPDATE_MS
	int "Drone update record period while detecting, ms (default of drone_comb.update_ms)"
	default 1000
	depends on SM_DETECTOR_DRONE_COMB

config SM_DETECTOR_GUNSHOT
	bool "Gunshot onset detector"
	default y

config SM_DETECTOR_DEPLOY_TONES
	bool "Deploy tone decoder"
	default y
	help
	  Decodes the 8-FSK tone frames a phone plays at each node during deployment (docs/deploy-tones.md)
	  and sends a TONE record for each one.

endif # SM_ROLE_NODE

module = SONICMESH
module-str = SonicMesh
source "subsys/logging/Kconfig.template.log_config"

endif # SONICMESH
```
